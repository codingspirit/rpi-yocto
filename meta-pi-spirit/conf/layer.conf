## meta-pi-spirit/conf/layer.conf
```bitbake
# We have a conf and classes directory, add to BBPATH
BBPATH .= ":${LAYERDIR}"

# We have recipes-* directories, add to BBFILES
BBFILES += "${LAYERDIR}/recipes-*/*/*.bb \
            ${LAYERDIR}/recipes-*/*/*.bbappend"

BBFILE_COLLECTIONS += "meta-pi-spirit"
BBFILE_PATTERN_meta-pi-spirit = "^${LAYERDIR}/"
BBFILE_PRIORITY_meta-pi-spirit = "6"
LAYERSERIES_COMPAT_meta-pi-spirit = "sumo"
```

## rpi-build/conf/bblayers.conf
```bitbake
# POKY_BBLAYERS_CONF_VERSION is increased each time build/conf/bblayers.conf
# changes incompatibly
POKY_BBLAYERS_CONF_VERSION = "2"

BBPATH = "${TOPDIR}"
BBFILES ?= ""
PROJECT_DIR := "${@os.path.abspath(os.path.dirname(d.getVar('FILE', True)) + '/../..')}"

BBLAYERS ?= " \
  ${PROJECT_DIR}/poky/meta \
  ${PROJECT_DIR}/poky/meta-poky \
  ${PROJECT_DIR}/poky/meta-yocto-bsp \
  ${PROJECT_DIR}/meta-raspberrypi \
  "
```
